#include "gameroy_advanced.dtsi"

&default_transform {
	col-offset = <18>;
};

&kscan0 {
    compatible = "zmk,kscan-gpio-direct";
    label = "KSCAN";
    input-gpios
        = <&gpio0 4 (GPIO_ACTIVE_LOW | GPIO_PULL_UP)>
        ;
 };